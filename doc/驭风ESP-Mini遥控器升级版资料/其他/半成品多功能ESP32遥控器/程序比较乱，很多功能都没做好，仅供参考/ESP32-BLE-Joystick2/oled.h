#ifndef OLED_H_
#define OLED_H_

#include <Wire.h>

//*********************OLED相关************************
#include <Adafruit_GFX.h>
#include <Adafruit_SSD1306.h>


//**************OLED*******************
#define OLED_RESET     4
Adafruit_SSD1306 display(128, 64, &Wire, OLED_RESET);
byte oledmode=1;

//取128*64 逐行式 顺向高位在前
static const unsigned char PROGMEM pic1[] = {
0x00,0x00,0x00,0x00,0x00,0x00,0x00,0x00,0x00,0x00,0x00,0x00,0x00,0x00,0x00,0x00,
0x00,0x00,0x00,0x00,0x00,0x00,0x00,0x00,0x00,0x00,0x00,0x00,0x00,0x00,0x00,0x00,
0x00,0x00,0x00,0x00,0x00,0x00,0x00,0x00,0x00,0x00,0x00,0x00,0x00,0x03,0xC0,0x00,
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0x00,0x00,0x00,0x00,0x00,0x00,0x00,0x00,0x00,0x00,0x00,0x00,0x00,0x00,0x00,0x00
};

void orb(int x,int y,int a,int r,int cr){//中心坐标x,y,起始角度a,环绕半径r圆形图案半径
  int x1=cos((a-90)*PI/180)*r;
  int y1=sin((a-90)*PI/180)*r;
  display.drawCircle(x1+x,y1+y,cr,SSD1306_WHITE);
}
void orb1(int x,int y,int a,int r,int cr){//中心坐标x,y,起始角度a,环绕半径r圆形图案半径
  int x1=cos((a-90)*PI/180)*r;
  int y1=sin((a-90)*PI/180)*r;
  display.fillCircle(x1+x,y1+y,cr,SSD1306_WHITE);
}

void oleddisplay(){
  if(oledmode==0){ 
    display.drawBitmap(0, 8, pic1, 128, 47, 1); //画出字符对应点阵数据
    display.display();//开显示  
    display.clearDisplay();//清屏  
  } else if (oledmode==1){
    display.clearDisplay();            //Clear the display 
//    if(!mode)
//    {
//      display.setCursor(2,0);
//      display.print("Mode: ");      
//      display.print("Debug"); 
//      display.invertDisplay(true);    //黑白翻转
//      display.setCursor(2,15);
//      display.print("PT1:");             
//      display.print(data.pot1);     
//      display.print("      PT2:");  
//      display.print(0);  //display.print(data.pot2); 
//    
//      if(!digitalRead(t1)){
//          display.setCursor(2,28);
//          display.print("ROLL:");             
//          display.print(data.roll);     
//          display.print("   PITCH:");  
//          display.print(data.pitch);       
//        } else {
//          display.setCursor(2,28);
//          display.print("SW1: ");             
//          display.print(digitalRead(t1));     
//          display.print("       SW2: ");  
//          display.print(digitalRead(t2)); 
//        }   
//      // 
//      display.setCursor(2,42);            //Select where to print 124 x 64
//      display.print("LY: ");             
//      display.print(LY_to_send);     
//      display.print("      RY: ");  
//      display.print(RY_to_send);    
//      display.setCursor(2,55);
//      display.print("LX: ");             
//      display.print(LX_to_send);     
//      display.print("      RX: ");  
//      display.print(RX_to_send);    
//      display.display();      
//    }
    if(mode)
    {    

      display.invertDisplay(false);    //黑白翻转
      
      for (int i=0;i<30;i++){           //外环
         orb(24,32,angle+i*12,24,0);
         orb(104,32,angle+i*12,24,0);
      }
      for (int i=0;i<map(data.pot1,0,255,1,10);i++){  //左电位器
         orb(24,32,i*6,31,random(2));
         orb(24,32,360-i*6,31,random(2));
      }
      for (int i=0;i<map(data.pot2,0,255,1,10);i++){  //右电位器     
         orb(104,32,i*6,31,random(2));
         orb(104,32,360-i*6,31,random(2));
      }
      
      if (data.tSwitch1 == 1){     //三颗行星
        orb(24,32,angle+235,24,2);
      } else {
        orb1(24,32,angle+235,24,3);
      }
      if (data.tSwitch2 == 1){     
        orb(104,32,angle+145,24,2);
      } else {
        orb1(104,32,angle+145,24,3);
      }
      orb(24,32,angle,15,random(2));
      orb(104,32,angle+30,15,0);
      orb(24,32,angle+100,18,0);
      orb(104,32,angle+230,19,random(2));
  
      if (data.j1Button == 1){
        display.drawCircle( map(data.j1PotX,255,0,39,9), map(data.j1PotY,255,0,47,17), 6, SSD1306_WHITE);
        display.drawCircle( map(data.j1PotX,255,0,39,9), map(data.j1PotY,255,0,47,17), 4, SSD1306_WHITE);
      } else {
        display.fillCircle( map(data.j1PotX,255,0,39,9), map(data.j1PotY,255,0,47,17), 6, SSD1306_WHITE);
      }
      if (data.j2Button == 1){
        display.drawCircle( map(data.j2PotX,255,0,119,89), map(data.j2PotY,255,0,47,17), 6, SSD1306_WHITE);
        display.drawCircle( map(data.j2PotX,255,0,119,89), map(data.j2PotY,255,0,47,17), 4, SSD1306_WHITE);
      } else {
        display.fillCircle( map(data.j2PotX,255,0,119,89), map(data.j2PotY,255,0,47,17), 6, SSD1306_WHITE);
      }
  
      if (data.tSwitch1 == 1){
        display.fillCircle(64, 32, random(2), SSD1306_WHITE);
      } else {
         for (int i=0;i<20;i++){           //中心外环
           orb(64,32,angle+i*18,14,0);
           display.fillCircle(map(data.roll,0,255,76,52), map(data.pitch,0,255,44,20), 2, SSD1306_WHITE);
        }
      }  
  
      if (data.buttonR2 == 1){
        display.drawCircle(42, 56, random(2), SSD1306_WHITE);
      } else {
        display.fillCircle(42, 56, 2, SSD1306_WHITE);
      }
      if (data.buttonR1 == 1){
        display.drawCircle(7, 61, random(2), SSD1306_WHITE);
      } else {
        display.fillCircle(7, 61, 2, SSD1306_WHITE);
      }
      if (data.buttonR4 == 1){
        display.drawCircle(124, 59, random(2), SSD1306_WHITE);
      } else {
        display.fillCircle(124, 59, 2, SSD1306_WHITE);
      }
      if (data.buttonR3 == 1){
        display.drawCircle(90, 57, random(2), SSD1306_WHITE);
      } else {
        display.fillCircle(90, 57, 2, SSD1306_WHITE);
      }        
    }
          
    display.display();  
    angle++;
    if (angle>359) angle=0;
    }
  }



#endif  
